## arch/arm/mach-zynq/Kconfig
```kconfig
# SPDX-License-Identifier: GPL-2.0
config ARCH_ZYNQ
	bool "Xilinx Zynq ARM Cortex A9 Platform"
	depends on ARCH_MULTI_V7
	select ARCH_HAS_RESET_CONTROLLER
	select ARCH_SUPPORTS_BIG_ENDIAN
	select ARM_AMBA
	select ARM_GIC
	select ARM_GLOBAL_TIMER if !CPU_FREQ
	select CADENCE_TTC_TIMER
	select HAVE_ARM_SCU if SMP
	select HAVE_ARM_TWD if SMP
	select MFD_SYSCON
	select PINCTRL
	select PINCTRL_ZYNQ
	select SOC_BUS
	help
	  Support for Xilinx Zynq ARM Cortex A9 Platform

if ARCH_ZYNQ

menu "Xilinx Specific Options"

config XILINX_PREFETCH
	bool "Cache Prefetch"
	default y
	help
	  This option turns on L1 & L2 cache prefetching to get the best performance
	  in many cases. This may not always be the best performance depending on
	  the usage.

config ESI_ZM1_VBUS_DETECT_DISABLE
	bool "eSi_ZM1 module VBUS detect disable"
	default n
	help
	  Say 'Y' here if you want to disable VBUS 5V detect for the on-board
	  usb phy. This option is required for 3.3V single rail operation.

config ESI_ZM1_MMC_ON_EMIO
	bool "eSi_ZM1 module micro sd card interface on EMIO pins"
	default n
	help
	  Say 'Y' here to set the maximum sd card clock frequency to 25MHz. This is
	  the maximum rate when the MMC interface is configured to use EMIO pins.

config ESI_ZM1_SHARED_MDIO
	bool "eSi_ZM1 module uses a shared MDIO bus for the ethernet phys"
	default n
	help
	  Say 'Y' here to set enable the use of the shared MDIO bus for ETH0 and ETH1.

endmenu

endif
```
